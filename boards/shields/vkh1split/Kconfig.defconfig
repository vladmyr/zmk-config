## boards/shields/vkh1split/Kconfig.defconfig
```kconfig
if SHIELD_VKH1SPLIT_LEFT

config ZMK_KEYBOARD_NAME
    default "vkh1split"

config ZMK_SPLIT_ROLE_CENTRAL
    default y

endif # SHIELD_VKH1SPLIT_LEFT

if SHIELD_VKH1SPLIT_LEFT || SHIELD_VKH1SPLIT_RIGHT

config ZMK_SPLIT
    default y

endif # SHIELD_VKH1SPLIT_LEFT || SHIELD_VKH1SPLIT_RIGHT
```

## boards/shields/vkh1split/Kconfig.shield
```kconfig
config SHIELD_VKH1SPLIT_LEFT
    def_bool $(shields_list_contains,vkh1split_left)

config SHIELD_VKH1SPLIT_RIGHT
    def_bool $(shields_list_contains,vkh1split_right)
```
