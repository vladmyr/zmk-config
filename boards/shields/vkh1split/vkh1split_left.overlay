// This file was generated from a template. Edit it to match your keyboard.
// See https://zmk.dev/docs/development/hardware-integration/new-shield for more
// instructions.

#include "vkh1split.dtsi"

&kscan {
    // Replace these comments with the GPIO pins in the matrix for the left side.
    // See https://zmk.dev/docs/development/hardware-integration/new-shield#shield-overlays
    row-gpios
        = <&pro_micro 5 (GPIO_ACTIVE_HIGH | GPIO_PULL_DOWN)> // p0.24
        , <&pro_micro 6 (GPIO_ACTIVE_HIGH | GPIO_PULL_DOWN)> // p1.00
        , <&pro_micro 7 (GPIO_ACTIVE_HIGH | GPIO_PULL_DOWN)> // p0.11
        , <&pro_micro 8 (GPIO_ACTIVE_HIGH | GPIO_PULL_DOWN)> // p1.04
        , <&pro_micro 9 (GPIO_ACTIVE_HIGH | GPIO_PULL_DOWN)> // p1.06
        ;
    //// Only columns 3 & 4 are working (0 based)
    // col-gpios
    //     = <&gpio0 2 GPIO_ACTIVE_HIGH>  // P0.02
    //     , <&gpio1 15 GPIO_ACTIVE_HIGH> // P1.15
    //     , <&gpio1 13 GPIO_ACTIVE_HIGH> // P1.13
    //     , <&gpio1 11 GPIO_ACTIVE_HIGH> // P1.11
    //     , <&gpio0 10 GPIO_ACTIVE_HIGH> // P0.10
    //     , <&gpio0 9 GPIO_ACTIVE_HIGH>  // P0.09
    //     ;
    col-gpios
        = <&pro_micro 19 GPIO_ACTIVE_HIGH> // P0.02
        , <&pro_micro 18 GPIO_ACTIVE_HIGH> // P1.15
        , <&pro_micro 15 GPIO_ACTIVE_HIGH> // P1.13
        , <&pro_micro 14 GPIO_ACTIVE_HIGH> // P1.11
        , <&pro_micro 16 GPIO_ACTIVE_HIGH> // P0.10
        , <&pro_micro 10 GPIO_ACTIVE_HIGH> // P0.09
        ;
};

